/*
 * graphics.c
 *
 *  Created on: Dec 2, 2023
 *      Author: Andre
 */

#include "graphics.h"

uint8_t GFX_frame_buffer[1024] = {0};

// https://lexus2k.github.io/ssd1306/group___l_c_d___f_o_n_t_s.html#ga7f8ff37e85ff2ea4e4dfe68a555028ad
const uint8_t GFX_font_5x7[] =
{
	0x00, 0x05, 0x07, 0x20,
	0x00, 0x00, 0x00, 0x00, 0x00, // sp
	0x00, 0x00, 0x5F, 0x00, 0x00, // !
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	0x14, 0x14, 0x14, 0x14, 0x14, // horiz lines // DEL
	0x00 						  // This byte is required for italic type of font
};

// http://javl.github.io/image2cpp/
const uint8_t MECHATRONIX_LAB_LOGO[] =
{
	0xff, 0xff, 0xff, 0xff, 0xff, 0xff, 0xff, 0xff, 0xff, 0xff, 0xff, 0xff, 0xff, 0xff, 0xff, 0xff,
	0xff, 0xff, 0xff, 0xff, 0xf3, 0x01, 0x01, 0xe1, 0xe1, 0xe1, 0xe1, 0xe1, 0xe1, 0xe1, 0xe1, 0xe1,
	0xe1, 0xe1, 0xe1, 0xe1, 0xe1, 0xe1, 0xe1, 0xe1, 0xe1, 0x01, 0x01, 0xf3, 0xff, 0xff, 0xff, 0xff,
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	0x9f, 0x9f, 0x9f, 0x9f, 0x9f, 0x9f, 0x8f, 0xcf, 0xc7, 0xe3, 0xf1, 0xf8, 0xfc, 0xff, 0xff, 0xff
};

void GFX_ClearFrame(uint8_t * frame_buffer)
{
	uint16_t i = 0;

	for (i = 0; i < FRAME_BUFFER_SIZE; i++)
	{
		frame_buffer[i] = 0;
	}
}

void GFX_DrawChar(uint8_t * font, uint8_t character)
{
	uint8_t column	= 0;

	for (column = 0; column < 5; column++)
	{
		OLED_SendData(font[(character - 0x20)*5 + column + 0x04]);
	}
}

void GFX_DrawString(uint8_t * font, char * string)
{
	uint8_t index	= 0;

	while(string[index] != '\0')
	{
		GFX_DrawChar(font, string[index]);
		index++;
	}
}

void GFX_DrawLogo(void)
{
	uint8_t page 	= 0;
	uint8_t column  = 0;
	uint16_t pixel 	= 0;

	for (page = 0; page < 8; page++)
	{
		OLED_SetCursor(0, page);

		for (column = 0; column < 64; column++)
		{
			OLED_SendData(MECHATRONIX_LAB_LOGO[pixel++]);
		}
	}
}

void GFX_DrawFrame(uint8_t * frame_buffer)
{
	uint8_t page 	= 0;
	uint8_t column  = 0;
	uint16_t sector = 0;

	for (page = 0; page < 8; page++)
	{
		OLED_SetCursor(0, page);

		for (column = 0; column < 128; column++)
		{
			OLED_SendData(frame_buffer[sector++]);
		}
	}
}

void GFX_DrawHorizontalLine	(uint8_t x, uint8_t y, uint8_t dx)
{
	uint8_t counter = 0;

	for (counter = 0; counter < dx; counter++)
	{
		GFX_frame_buffer[x + 128 * (y / 8)] |= 0x01 << (y % 8);
		x++;
	}
}

void GFX_DrawVerticalLine	(uint8_t x, uint8_t y, uint8_t dy)
{
	uint8_t counter = 0;

	for (counter = 0; counter < dy; counter++)
	{
		GFX_frame_buffer[x + 128 * (y / 8)] |= 0x01 << (y % 8);
		y++;
	}
}

void GFX_DrawDiagonalLine	(uint8_t x, uint8_t y, uint8_t dx_dy)
{
	uint8_t counter = 0;

	for (counter = 0; counter < dx_dy; counter++)
	{
		GFX_frame_buffer[x + 128 * (y / 8)] |= 0x01 << (y % 8);
		x++;
		y++;
	}
}

void GFX_DrawLineOctant0	(uint8_t x, uint8_t y, uint8_t dx, uint8_t dy, int8_t x_direction)
{
	int32_t dy2, dy2_dx2, error;

	dy2 = 2*dy;
	dy2_dx2 = dy2 - 2 * dx;
	error = dy2 - (int32_t) dx;

	GFX_frame_buffer[x + 128 * (y / 8)] |= 0x01 << (y % 8);
	while (dx--)
	{
		if (error > 0)
		{
			y++;
			error += dy2_dx2;
		}
		else
		{
			error += dy2;
		}

		x += x_direction;

		GFX_frame_buffer[x + 128 * (y / 8)] |= 0x01 << (y % 8);
	}
}

void GFX_DrawLineOctant1	(uint8_t x, uint8_t y, uint8_t dx, uint8_t dy, int8_t x_direction)
{
	int32_t dx2, dx2_dy2, error;

	dx2 = 2*dx;
	dx2_dy2 = dx2 - 2 * dy;
	error = dx2 - (int32_t) dy;

	GFX_frame_buffer[x + 128 * (y / 8)] |= 0x01 << (y % 8);
	while (dy--)
	{
		if (error > 0)
		{
			x += x_direction;
			error += dx2_dy2;
		}
		else
		{
			error += dx2;
		}

		y++;

		GFX_frame_buffer[x + 128 * (y / 8)] |= 0x01 << (y % 8);
	}
}

void GFX_DrawLine(int8_t x0, int8_t y0, int8_t x1, int8_t y1)
{
	// Based on Bresenham's algorithm. Source:
	// http://www.phatcode.net/res/224/files/html/ch35/35-01.html

	int8_t dx, dy;
	int8_t swap_aux;

	if (y0 > y1)
	{
		swap_aux = y0;
		y0 = y1;
		y1 = swap_aux;

		swap_aux = x0;
		x0 = x1;
		x1 = swap_aux;
	}

	dx = x1 - x0;
	dy = y1 - y0;

	if (dx > 0)
	{
		if (dx > dy)
		{
			GFX_DrawLineOctant0(x0, y0, dx, dy, 1);
		}
		else
		{
			GFX_DrawLineOctant1(x0, y0, dx, dy, 1);
		}
	}
	else
	{
		dx = -dx;

		if (dx > dy)
		{
			GFX_DrawLineOctant0(x0, y0, dx, dy, -1);
		}
		else
		{
			GFX_DrawLineOctant1(x0, y0, dx, dy, -1);
		}
	}
	GFX_DrawFrame(GFX_frame_buffer);
}

void GFX_DrawTriangle (int8_t x0, int8_t y0, int8_t x1, int8_t y1, int8_t x2, int8_t y2)
{
	GFX_DrawLine(x0, y0, x1, y1);
	GFX_DrawLine(x1, y1, x2, y2);
	GFX_DrawLine(x2, y2, x0, y0);
}

void GFX_FillRectangle(uint8_t x, uint8_t y, uint8_t dx, uint8_t dy)
{
	uint8_t counter = 0;

	for (counter = 0; counter < dy; counter++)
	{
		GFX_DrawHorizontalLine(x, (y + counter), dx);
	}
	GFX_DrawFrame(GFX_frame_buffer);
}

