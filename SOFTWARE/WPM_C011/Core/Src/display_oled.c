/*
 * display_oled.c
 *
 *  Created on: Nov 11, 2023
 *      Author: Andre
 */

#include "display_oled.h"

// TODO: map device commands in the .h file

// https://lexus2k.github.io/ssd1306/group___l_c_d___f_o_n_t_s.html#ga7f8ff37e85ff2ea4e4dfe68a555028ad
const uint8_t font5x7[] =
{
	0x00, 0x05, 0x07, 0x20,
	0x00, 0x00, 0x00, 0x00, 0x00, // char ' ' (0x20/32)
	0x00, 0x00, 0x2E, 0x00, 0x00, // char '!' (0x21/33)
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	0x36, 0x41, 0x36, 0x00, 0x00, // char '' (0x7F/127)
};

// http://javl.github.io/image2cpp/
const uint8_t MECHATRONIX_LAB_LOGO[] =
{
	0xff, 0xff, 0xff, 0xff, 0xff, 0xff, 0xff, 0xff, 0xff, 0xff, 0xff, 0xff, 0xff, 0xff, 0xff, 0xff,
	0xff, 0xff, 0xff, 0xff, 0xf3, 0x01, 0x01, 0xe1, 0xe1, 0xe1, 0xe1, 0xe1, 0xe1, 0xe1, 0xe1, 0xe1,
	0xe1, 0xe1, 0xe1, 0xe1, 0xe1, 0xe1, 0xe1, 0xe1, 0xe1, 0x01, 0x01, 0xf3, 0xff, 0xff, 0xff, 0xff,
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	0x9f, 0x9f, 0x9f, 0x9f, 0x9f, 0x9f, 0x8f, 0xcf, 0xc7, 0xe3, 0xf1, 0xf8, 0xfc, 0xff, 0xff, 0xff
};

void OLED_SendCommand(uint8_t command)
{
	uint8_t I2C_buffer[2];

	I2C_buffer[0] = SSD1306_REGISTER_COMMAND;
	I2C_buffer[1] = command;
	HAL_I2C_Master_Transmit(&hi2c1, SSD1306_DEVICE_ADDRESS, I2C_buffer, 2, 1000);
}

void OLED_SendData(uint8_t data)
{
	uint8_t I2C_buffer[2];

	I2C_buffer[0] = SSD1306_REGISTER_DATA;
	I2C_buffer[1] = data;
	HAL_I2C_Master_Transmit(&hi2c1, SSD1306_DEVICE_ADDRESS, I2C_buffer, 2, 1000);
}

void OLED_SetCursor(uint8_t x, uint8_t page)
{
	OLED_SendCommand(0x00 + ( x       & 0x0F));
	OLED_SendCommand(0x10 + ((x >> 4) & 0x0F));

	OLED_SendCommand(0xB0 + page);
}

void OLED_SetPixel(uint8_t x, uint8_t y)
{
	OLED_SetCursor(x, (y / 8));
	OLED_SendData(0x01 << (y % 8));
}

void OLED_Clear(void)
{
	uint8_t page 	= 0;
	uint8_t column  = 0;

	for (page = 0; page < 8; page++)
	{
		OLED_SetCursor(0, page);

		for (column = 0; column < 128; column++)
		{
			OLED_SendData(0x00);
		}
	}
}

void OLED_Sleep(void)
{
	OLED_SendCommand(0xAE); 	// Turn off screen
}

void OLED_WakeUp(void)
{
	OLED_SendCommand(0xAF); 	// Turn on screen
}

void OLED_DarkBG(void)
{
	OLED_SendCommand(0xA6);		// Dark background (Normal Display)
}

void OLED_LightBG(void)
{
	OLED_SendCommand(0xA7);		// Light background (Inverse Display)
}

void OLED_Init(void)
{
	HAL_GPIO_WritePin(OLED_RESET_GPIO_Port, OLED_RESET_Pin, 0);
	HAL_Delay(100);
	HAL_GPIO_WritePin(OLED_RESET_GPIO_Port, OLED_RESET_Pin, 1);

	OLED_WakeUp(); 				// Turn on display
	OLED_DarkBG();				// Normal mode (dark background)
	OLED_SendCommand(0x20);		// Set memory addressing mode
	OLED_SendCommand(0x02);			// Set Page Mode
	OLED_SendCommand(0x8D);		// Charge pump
	OLED_SendCommand(0x14);			// Charge pump
	OLED_SendCommand(0x81);		// Set contrast
	OLED_SendCommand( 127);			// Default
	OLED_SendCommand(0xC8);		// Pages Remapping
	OLED_SendCommand(0xA1);		// Columns Remapping

	OLED_Clear();
	OLED_DrawLogo();
}

void OLED_DrawChar(uint8_t * font, uint8_t character)
{
	uint8_t column	= 0;

	for (column = 0; column < 5; column++)
	{
		OLED_SendData(font[(character - 0x20)*5 + column + 0x04]);
	}
}

void OLED_DrawString(uint8_t * font, char * string)
{
	uint8_t index	= 0;

	while(string[index] != '\0')
	{
		OLED_DrawChar(font, string[index]);
		index++;
	}
}

void OLED_DrawLogo(void)
{
	uint8_t page 	= 0;
	uint8_t column  = 0;
	uint16_t pixel 	= 0;

	for (page = 0; page < 8; page++)
	{
		OLED_SetCursor(0, page);

		for (column = 0; column < 64; column++)
		{
			OLED_SendData(MECHATRONIX_LAB_LOGO[pixel++]);
		}
	}
}

void OLED_DrawFrame(uint8_t * frame_buffer)
{
	uint8_t page 	= 0;
	uint8_t column  = 0;
	uint16_t pixel 	= 0;

	for (page = 0; page < 8; page++)
	{
		OLED_SetCursor(0, page);

		for (column = 0; column < 128; column++)
		{
			OLED_SendData(frame_buffer[pixel++]);
		}
	}
}

void OLED_DrawLine(uint8_t xi, uint8_t yi, uint8_t xf, uint8_t yf)
{
	uint8_t counter = 0;
	int32_t x, y, dx, dy;

	x = xi;
	y = yi * 1000;

	dx = (xf - xi + 1);
	dy = (yf - yi + 1) * 1000;

	for (counter = 0; counter < dx; counter++)
	{
		y = yi + (x - xi) * dy / dx;
		if (y - (1000 * counter) > 500)
		{
			y += 1000;
		}
		OLED_SetPixel(x, (y / 1000));

		x++;
	}
}

void OLED_DrawLineH(uint8_t xi, uint8_t yi, uint8_t w)
{
	uint8_t counter = 0;

	for (counter = 0; counter < w; counter++)
	{
		OLED_SetPixel(xi, yi);
		xi++;
	}
}
