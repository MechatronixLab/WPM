/*
 * display.c
 *
 *  Created on: Feb 10, 2024
 *      Author: Eng. André A. M. Araújo
 */

#include "display.h"

// Mechatronix Lab Logo
//
// 	To convert a bitmap to an array, use this website and the following configurations:
// 		http://javl.github.io/image2cpp/
//			Code output format: Arduino code
//			Draw mode: 			Vertical - 1 bit per pixel
//
//	Then, copy array contents from the page to the array:
static const uint8_t MECHATRONIX_LAB_LOGO_64x64[] =
{
	0x00, 0x00, 0x00, 0x00, 0x00, 0x00, 0x00, 0x00, 0x00, 0x00, 0x00, 0x00, 0x00, 0x00, 0x00, 0x00,
	0x00, 0x00, 0x00, 0x00, 0x0c, 0xfe, 0xfe, 0x1e, 0x1e, 0x1e, 0x1e, 0x1e, 0x1e, 0x1e, 0x1e, 0x1e,
	0x1e, 0x1e, 0x1e, 0x1e, 0x1e, 0x1e, 0x1e, 0x1e, 0x1e, 0xfe, 0xfe, 0x0c, 0x00, 0x00, 0x00, 0x00,
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	0x60, 0x60, 0x60, 0x60, 0x60, 0x60, 0x70, 0x30, 0x38, 0x1c, 0x0e, 0x07, 0x03, 0x00, 0x00, 0x00
};

static const uint8_t ST_LOGO_64x32[] =
{
	0x00, 0x00, 0x00, 0x00, 0x00, 0x00, 0x00, 0x00, 0x00, 0xc0, 0xe0, 0xf8, 0xf8, 0xfc, 0xfc, 0x7e,
	0x7e, 0x3e, 0x3e, 0x1e, 0x1e, 0x1e, 0x1e, 0x1e, 0x1e, 0x1e, 0x1e, 0x1e, 0x1e, 0x1e, 0x1e, 0x1e,
	0x1e, 0x1e, 0x1e, 0x1e, 0x1e, 0x1e, 0x1e, 0x1e, 0x1e, 0x1e, 0x1e, 0x1e, 0x1e, 0x1e, 0x1e, 0x1e,
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	0x3f, 0x1f, 0x0f, 0x07, 0x00, 0x00, 0x00, 0x00, 0x00, 0x00, 0x00, 0x00, 0x00, 0x00, 0x00, 0x00
};

static const uint8_t ELEKTOR_LOGO_64x32[] =
{
	0x00, 0x00, 0x00, 0x00, 0x00, 0x00, 0x80, 0x80, 0x80, 0xc0, 0xc0, 0xc0, 0xc0, 0x80, 0x80, 0x80,
	0x00, 0x00, 0x00, 0x00, 0x00, 0x00, 0x00, 0x00, 0x00, 0x00, 0x00, 0x00, 0x00, 0x00, 0x00, 0x00,
	0x00, 0x00, 0x00, 0x00, 0x00, 0x00, 0x00, 0x00, 0x00, 0x00, 0x00, 0x00, 0x00, 0x00, 0x00, 0x00,
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	0x00, 0x00, 0x00, 0x00, 0x00, 0x00, 0x00, 0x00, 0x00, 0x00, 0x00, 0x00, 0x00, 0x00, 0x00, 0x00
};

void DISPLAY_Init(void)
{
	uint16_t dt = 10;
	uint8_t i = 0;

	OLED_Init();
	GFX_DrawLogo( 0, 0,64,64, (uint8_t *) MECHATRONIX_LAB_LOGO_64x64);
	OLED_SetCursor(64, 0);
	GFX_DrawString((uint8_t *)GFX_font_5x7, "WEARABLE  ");
	OLED_SetCursor(64, 1);
	GFX_DrawString((uint8_t *)GFX_font_5x7, "PATIENT   ");
	OLED_SetCursor(64, 2);
	GFX_DrawString((uint8_t *)GFX_font_5x7, "MONITOR   ");
	OLED_SetCursor(64, 6);
	GFX_DrawString((uint8_t *)GFX_font_5x7, "ENG. ANDRE");
	OLED_SetCursor(64, 7);
	GFX_DrawString((uint8_t *)GFX_font_5x7, "A.M.ARAUJO");

	for (i = 0; i < 6; i++)	// Sweep LEDs thrice
	{
		HAL_GPIO_TogglePin(LED3_GPIO_Port, LED3_Pin);
		HAL_Delay(dt);
		HAL_GPIO_TogglePin(LED2_GPIO_Port, LED2_Pin);
		HAL_Delay(dt);
		HAL_GPIO_TogglePin(LED1_GPIO_Port, LED1_Pin);
		HAL_Delay(dt);
	}

	HAL_Delay(14 * dt);

	OLED_SetCursor(64, 0);
	GFX_DrawString((uint8_t *)GFX_font_5x7, "WPM-WL55  ");
	OLED_SetCursor(64, 1);
	GFX_DrawString((uint8_t *)GFX_font_5x7, "V: 0.0.1  ");
	OLED_SetCursor(64, 2);
	GFX_DrawString((uint8_t *)GFX_font_5x7, "2024.02.29");

	HAL_Delay(20 * dt);

	OLED_Clear();

	OLED_SetCursor(0, 0);
	GFX_DrawString((uint8_t *)GFX_font_5x7, "STM32     ");
	OLED_SetCursor(0, 1);
	GFX_DrawString((uint8_t *)GFX_font_5x7, "WIRELESS  ");
	OLED_SetCursor(0, 2);
	GFX_DrawString((uint8_t *)GFX_font_5x7, "INNOVATION");
	OLED_SetCursor(0, 3);
	GFX_DrawString((uint8_t *)GFX_font_5x7, "DESIGN    ");
	OLED_SetCursor(0, 4);
	GFX_DrawString((uint8_t *)GFX_font_5x7, "CONTEST   ");
	OLED_SetCursor(0, 7);
	GFX_DrawString((uint8_t *)GFX_font_5x7, "2024      ");

	GFX_DrawLogo(64, 0,64,32, (uint8_t *) ST_LOGO_64x32);
	GFX_DrawLogo(64, 4,64,32, (uint8_t *) ELEKTOR_LOGO_64x32);

	HAL_Delay(20 * dt);

	OLED_Clear();
}

void DISPLAY_DrawPleth(OXIMETRY_raw_data_t * data)
{
	static uint32_t pleth_min =    1 << 19;	// Raw signal is 18-bit wide
	static uint32_t pleth_max = 0x00000000;

	static uint8_t  graph_min = 32;
	static uint8_t  graph_max = 63;
	static uint16_t graph_x = 0;
	static uint8_t  graph_y = 0;

	if (data->infrared < 1000)	// Finger off sensor
	{
		data->infrared = 0;
	}

	if (data->infrared < pleth_min)
	{
		pleth_min = data->infrared;
	}

	if (data->infrared > pleth_max)
	{
		pleth_max = data->infrared;
	}

	graph_y = (uint8_t) AUX_Map(data->infrared, pleth_min, pleth_max, graph_min, graph_max);
	if (graph_y == 0)
	{
		graph_y = 63;
	}

	GFX_DrawLine(graph_x, graph_y, graph_x, 63);

	graph_x++;
	if (graph_x > (SCREEN_WIDTH - 1))
	{
		graph_x = 0;
		pleth_min = 1 << 19;
		pleth_max = 0x00000000;
		GFX_ClearFrame(GFX_frame_buffer);
	}
}
